## config/boards/arm/vua/Kconfig.board
```kconfig
#
# Copyright (c) 2023 Deemen17
# SPDX-License-Identifier: MIT
#

config BOARD_VUA_DONGLE
	bool "vua_dongle"
	depends on SOC_NRF52840_QIAA

config BOARD_VUA_LEFT
	bool "vua_left"
	depends on SOC_NRF52840_QIAA

config BOARD_VUA_RIGHT
	bool "vua_right"
	depends on SOC_NRF52840_QIAA
```

## config/boards/arm/vua/Kconfig.defconfig
```kconfig
#
# Copyright (c) 2023 Deemen17
# SPDX-License-Identifier: MIT
#

if BOARD_VUA_DONGLE

config ZMK_KEYBOARD_NAME
	default "VU.A"

config ZMK_SPLIT
	default y

config ZMK_SPLIT_BLE_ROLE_CENTRAL
	default y

endif # BOARD_VUA_DONGLE

if BOARD_VUA_LEFT || BOARD_VUA_RIGHT

config BOARD
	default "VUA"

config I2C
	bool
	default y

config SPI
    bool
    default y

endif # BOARD_VUA_LEFT || BOARD_VUA_RIGHT

if BOARD_VUA_LEFT || BOARD_VUA_RIGHT || BOARD_VUA_DONGLE

config ZMK_SPLIT
	default y

if USB

config USB_DEVICE_STACK
	default y

if USB_DEVICE_STACK

config USB_NRFX
	default y

endif # USB_DEVICE_STACK

endif # USB

config BT_CTLR
	default BT

endif # BOARD_VUA_LEFT || BOARD_VUA_RIGHT || BOARD_VUA_DONGLE
```
