## config/boards/arm/vua/Kconfig.shield
```kconfig
#
# Copyright (c) 2023 Deemen17
# SPDX-License-Identifier: MIT
#

config BOARD_VUA_DONGLE
	def_bool $(shields_list_contains,vua_dongle)

config BOARD_VUA_LEFT
	def_bool $(shields_list_contains,vua_left)

config BOARD_VUA_RIGHT
	def_bool $(shields_list_contains,vua_right)
```

## config/boards/deemen17/vua/Kconfig.vua_left
```kconfig
#
# Copyright (c) 2023 Deemen17
# SPDX-License-Identifier: MIT
#

config BOARD_VUA_LEFT
	select SOC_NRF52840_QIAA
	select ZMK_BOARD_COMPAT
	imply RETAINED_MEM
	imply RETENTION
	imply RETENTION_BOOT_MODE
```

## config/boards/deemen17/vua/board.yml
```yaml
boards:
  - name: vua_left
    vendor: deemen17
    socs:
      - name: nrf52840
  - name: vua_right
    vendor: deemen17
    socs:
      - name: nrf52840
```

## config/boards/shields/vua/Kconfig.defconfig
```kconfig
#
# Copyright (c) 2023 Deemen17
# SPDX-License-Identifier: MIT
#

if BOARD_VUA_DONGLE_DISPLAY || BOARD_VUA_DONGLE_SIMPLE

	config ZMK_KEYBOARD_NAME
		default "VU.A"

	config ZMK_SPLIT
		default y

	config ZMK_SPLIT_BLE_ROLE_CENTRAL
		default y

endif # BOARD_VUA_DONGLE_DISPLAY || BOARD_VUA_DONGLE_SIMPLE

if BOARD_VUA_LEFT || BOARD_VUA_RIGHT

	config BOARD
		default "VUA"

	config I2C
		bool
		default y

	config SPI
		bool
		default y

endif # BOARD_VUA_LEFT || BOARD_VUA_RIGHT

if BOARD_VUA_LEFT || BOARD_VUA_RIGHT || BOARD_VUA_DONGLE_DISPLAY || BOARD_VUA_DONGLE_SIMPLE

	config ZMK_SPLIT
		default y

	if USB

		config USB_DEVICE_STACK
			default y

		if USB_DEVICE_STACK

			config USB_NRFX
				default y

		endif # USB_DEVICE_STACK

	endif # USB

	config BT_CTLR
		default BT

	if ZMK_DISPLAY

		config I2C
			default y

		config SSD1306
			default y

		choice ZMK_DISPLAY_WORK_QUEUE
			default ZMK_DISPLAY_WORK_QUEUE_DEDICATED
		endchoice

	endif # ZMK_DISPLAY

	if SSD1306

		config LV_Z_VDB_SIZE
			default 64

		config LV_DPI_DEF
			default 148

		config LV_Z_BITS_PER_PIXEL
			default 1

		choice LV_COLOR_DEPTH
			default LV_COLOR_DEPTH_1
		endchoice

	endif # SSD1306

	if ZMK_BACKLIGHT

		config PWM
			default y

		config LED_PWM
			default y

	endif # ZMK_BACKLIGHT

endif # BOARD_VUA_LEFT || BOARD_VUA_RIGHT || BOARD_VUA_DONGLE_DISPLAY || BOARD_VUA_DONGLE_SIMPLE
```

## config/boards/shields/vua/Kconfig.shield
```kconfig
#
# Copyright (c) 2023 Deemen17
# SPDX-License-Identifier: MIT
#

config BOARD_VUA_DONGLE_DISPLAY
	def_bool $(shields_list_contains,vua_dongle_display)

config BOARD_VUA_DONGLE_SIMPLE
	def_bool $(shields_list_contains,vua_dongle_simple)

config BOARD_VUA_LEFT
	def_bool $(shields_list_contains,vua_left)

config BOARD_VUA_RIGHT
	def_bool $(shields_list_contains,vua_right)
```

## config/dts/bindings/behaviors/zmk,behavior-hold-reset.yaml
```yaml
# Copyright (c) 2026 Deemen17
# SPDX-License-Identifier: MIT

description: |
  Reset behavior that only fires once the key has been held for a minimum
  duration, then released.

  Unlike the stock &sys_reset / &bootloader behaviors, this is safe to invoke
  from a zmk,kscan-sideband-behaviors entry pointed at a key that is also part
  of the normal matrix: a short tap does nothing, so the key keeps its usual
  meaning. Because sideband entries run locally, this works on a split
  peripheral even while it is disconnected from the central.

  Setting bootloader-hold-time-ms adds a second, longer tier that reboots into
  the bootloader. The tier is decided on release, so the shorter action is
  selected by releasing between the two thresholds.

compatible: "zmk,behavior-hold-reset"

include: zero_param.yaml

properties:
  hold-time-ms:
    type: int
    default: 3000
    description: Milliseconds the key must be held before releasing it triggers the reset.
  bootloader-hold-time-ms:
    type: int
    default: 0
    description: >
      Milliseconds the key must be held for the reset to enter the bootloader
      instead. Must be greater than hold-time-ms. 0 disables this second tier.
  bootloader:
    type: boolean
    description: >
      Make the hold-time-ms tier itself enter the bootloader, rather than
      rebooting back into the firmware.
  type:
    type: int
    default: 0
    description: Legacy sys_reboot() type, used only when boot retention is unavailable.
```
