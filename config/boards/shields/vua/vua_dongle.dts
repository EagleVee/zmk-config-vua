/*
*
* Copyright (c) 2023 Deemen17
* SPDX-License-Identifier: MIT
*
*/

#include "vua.dtsi"

/{
	kscan0: kscan {
		compatible = "zmk,kscan-gpio-matrix";
		label = "KSCAN";
		
		diode-direction = "row2col";
		
		row-gpios
		= <&gpio0 9  GPIO_ACTIVE_HIGH>
		;
		col-gpios
		= <&gpio0 10 (GPIO_ACTIVE_HIGH | GPIO_PULL_DOWN)>
		;
	};
};


